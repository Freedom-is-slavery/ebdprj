#include "stdio.h"
#include "wiringPi.h"
#include "MAX7219.h"

const uint8_t dismap[36][8] = {
    {0x3C,0x42,0x42,0x42,0x42,0x42,0x42,0x3C},      //0
    {0x10,0x18,0x14,0x10,0x10,0x10,0x10,0x10},      //1
    {0x7E,0x02,0x02,0x7E,0x40,0x40,0x40,0x7E},      //2
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    {0x00,0x7F,0x02,0x04,0x08,0x10,0x20,0x7F}       //Z
};

int main(void)
{
    uint8_t i, ad, ch;
    printf("Initializing......\n");
    RPi_GPIO_Init();
    MAX7219_Init();
    printf("Initialized!\n");
    delay(1000);
    while (1)
    {
        printf("Input char to display:");
        scanf("%d", &ch);
        if (ch >= 36)
            break;          //输入超过表的范围则直接退出
        for (ad = REG_DIGIT0; ad <= REG_DIGIT7; ad++)
        {
            MAX7219_Write(ad, dismap[ch][ad-1]); 
        }
        delay(1500);
    }
    return 0;
}

/**
 * @brief 树莓派这边GPIO的初始化
 *  
 */
void RPi_GPIO_Init(void)
{
    wiringPiSetup();
    pinMode(GPIO_CLK, OUTPUT);
    pinMode(GPIO_LOAD, OUTPUT);
    pinMode(GPIO_DIN, OUTPUT);
}

/**
 * @brief MAX7219相关寄存器的初始化
 *  
 */
void MAX7219_Init(void)
{
    MAX7219_Write(REG_DECODE_MODE, NO_DECODE);
    MAX7219_Write(REG_INTENSITY, LIGHT_MAX);
    MAX7219_Write(REG_SCANLIMIT, SCAN_8BIT);
    MAX7219_Write(REG_DISPLAYTEST, FORBID_TEST);
    MAX7219_Write(REG_SHUTDOWN, NORMAL_OPERATION);
}

/**
 * @brief 向MAX7219的某地址寄存器写一个字节的数据
 *  
 */
void MAX7219_Write(uint8_t addr, uint8_t data)
{
    digitalWrite(GPIO_LOAD, LOW);       //拉低LOAD，开始送16bit数据
    delayMicroseconds(1);
    MAX7219_WriteByte(addr);
    MAX7219_WriteByte(data);
    digitalWrite(GPIO_LOAD, HIGH);      //拉高LOAD，锁存16bit
    delayMicroseconds(1);
}

/**
 * @brief 向MAX7219写一个字节的数据
 *  
 */
void MAX7219_WriteByte(uint8_t data)
{
    for (int i = 1; i <= 8; i++)
    {
        digitalWrite(GPIO_CLK, LOW);
        delayMicroseconds(1);       //延时1us保证CLK速率低于10MHz
        if (data & 0X80)
            digitalWrite(GPIO_DIN, HIGH);
        else
            digitalWrite(GPIO_DIN, LOW);
        data <<= 1;
        digitalWrite(GPIO_CLK, HIGH);
        delayMicroseconds(1);
    }
}